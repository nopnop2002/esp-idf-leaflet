## main/Kconfig.projbuild
```kconfig
menu "Application configuration"

	config GPIO_RANGE_MAX
		int
		default 33 if IDF_TARGET_ESP32
		default 46 if IDF_TARGET_ESP32S2
		default 48 if IDF_TARGET_ESP32S3
		default 18 if IDF_TARGET_ESP32C2
		default 19 if IDF_TARGET_ESP32C3
		default 30 if IDF_TARGET_ESP32C6

	config ESP_WIFI_SSID
		string "WiFi SSID"
		default "myssid"
		help
			SSID (network name) to connect to.

	config ESP_WIFI_PASSWORD
		string "WiFi Password"
		default "mypassword"
		help
			WiFi password (WPA or WPA2) to connect to.

	config ESP_MAXIMUM_RETRY
		int "Maximum retry"
		default 5
		help
			Set the Maximum retry to avoid station reconnecting to the AP unlimited when the AP is really inexistent.

	config MDNS_HOSTNAME
		string "mDNS Hostname"
		default "esp32"
		help
			The mDNS host name used by the ESP32.

	choice MODE_SELECTION
		prompt "Select operating mode"
		default MODE_DEMO
		help
			Select operating mode
		config MODE_DEMO
			bool "Demonstration"
			help
				Demonstration.
		config MODE_GPS
			bool "Using GPS"
			help
				Using GPS.
		config MODE_MOVE
			bool "Moving through Central Park"
			help
				Moving through Central Park.
		config MODE_SETPOINT
			bool "Move according to set point"
			help
				Move according to set point.
	endchoice

	config UART_RX_GPIO
		depends on MODE_GPS
		int "UART RX GPIO number"
		range 0 GPIO_RANGE_MAX
		default 16 if IDF_TARGET_ESP32
		default  1 if IDF_TARGET_ESP32S2 || IDF_TARGET_ESP32S3
		default  0 # C3 and others
		help
			GPIO number (IOxx) to UART RX.

endmenu
```
